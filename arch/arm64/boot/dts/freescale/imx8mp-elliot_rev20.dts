// SPDX-License-Identifier: (GPL-2.0+ OR MIT)
/*
 * Brighton Elliot carrier board, rev20.
 *
 * Layers on top of the base imx8mp-elliot.dts. The only carrier delta vs the
 * base (which already brings USB-C/hd3ss3220 + i2c4 from the SOM dtsi) is the
 * gigabit Ethernet: ENET_QOS (&eqos) with the Atheros AT8031 RGMII PHY, ported
 * from the verified 12.1 imx8mp-elliot_rev20.dts. rev20 wires the PHY interrupt
 * to GPIO3_IO14 (rev10 uses GPIO3_IO02 — that is the only rev10/rev20 delta).
 */

/dts-v1/;

#include "imx8mp-elliot.dts"

/ {
	model = "Brighton Elliot i.MX8MPlus rev20";
	dtb_filename = "imx8mp-elliot_rev20.dtb";
	/* rev20 boards are auto-detected by U-Boot (KSZ PHY -> board_rv=_r20), so
	 * the first compatible carries the _r20 suffix to match the bootscript
	 * dtexp ezurio,imx8mp-${board}${board_rv}${mcore}. */
	compatible = "ezurio,imx8mp-elliot_r20", "brighton,imx8mp-elliot",
		     "ezurio,imx8mp-nitrogen8mp", "fsl,imx8mp";
};

/* ENET_QOS DISABLED — no PHY is populated on the EQOS MDIO bus (verified on
 * fielded 12.1 hardware: /sys/bus/mdio_bus has only the FEC's AT8031 at addr 4;
 * 12.1's eth1 sat PHY-less with a random MAC, admin-down, unused — its DT node
 * used Boundary's out-of-tree reg-mask scan, which mainline 6.6 ignores anyway).
 * On A15 the PHY-less netdev made the PHY attach fail -ENODEV and netd SIGABRT.
 * The product port is eth0 (FEC). Node kept for documentation. */
&eqos {
	pinctrl-names = "default";
	pinctrl-0 = <&pinctrl_eqos>;
	phy-mode = "rgmii-id";
	phy-handle = <&ethphy_qos>;
	status = "disabled";

	mdio {
		compatible = "snps,dwmac-mdio";
		#address-cells = <1>;
		#size-cells = <0>;

		ethphy_qos: ethernet-phy@4 {
			compatible = "ethernet-phy-ieee802.3-c22";
			reg = <4>;
			at803x,hib-disabled;
			eee-broken-1000t;
			interrupt-parent = <&gpio3>;
			interrupts = <14 IRQ_TYPE_LEVEL_LOW>;
			rxc-skew-ps = <3000>;
			txc-skew-ps = <3000>;
			rxdv-skew-ps = <0>;
			txen-skew-ps = <0>;
		};
	};
};
