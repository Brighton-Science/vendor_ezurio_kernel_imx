// SPDX-License-Identifier: (GPL-2.0+ OR MIT)
/*
 * Brighton Elliot rev20 — 12.1-bootloader-compatible alias.
 *
 * Identical DT content to imx8mp-elliot_rev20.dts; the only difference is the
 * first compatible string is "boundary,imx8mp-nitrogen8mp" so that an Android
 * 12.1 U-Boot (which uses board="nitrogen8mp" + dtexp="boundary,imx8mp-${board}")
 * picks this dtbo entry after the OS has been OTA'd from 12.1 -> 15. The
 * deployed bootloader stays on the fielded device (A/B OTA never updates the
 * bootloader); this alias lets it find a matching A15 dtbo entry to apply.
 *
 * A15's native bootloader uses board="elliot" -> ezurio,imx8mp-elliot, which is
 * served by imx8mp-elliot_rev20.dtb (sibling entry in the dtbo).
 */

/dts-v1/;

#include "imx8mp-elliot_rev20.dts"

/ {
	model = "Brighton Elliot i.MX8MPlus rev20 (Android 12.1 OTA compat)";
	/* Put boundary,imx8mp-nitrogen8mp first so the 12.1 bootloader's
	 * compatible-match finds it. The other strings remain for parity. */
	compatible = "boundary,imx8mp-nitrogen8mp",
		     "ezurio,imx8mp-elliot_r20", "brighton,imx8mp-elliot",
		     "ezurio,imx8mp-nitrogen8mp", "fsl,imx8mp";
};
