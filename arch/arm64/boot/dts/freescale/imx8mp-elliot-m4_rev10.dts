// SPDX-License-Identifier: (GPL-2.0+ OR MIT)
/*
 * Brighton Elliot rev10 with the Cortex-M7 enabled (RPMsg + shared memory).
 * = imx8mp-elliot_rev10.dts + the shared M7 enablement. Selected on a rev10
 * board with the M7 enabled: board=elliot, board_rv empty, mcore=-rpmsg ->
 * compatible "ezurio,imx8mp-elliot-rpmsg".
 */

/dts-v1/;

#include "imx8mp-elliot_rev10.dts"
#include "imx8mp-elliot-m7.dtsi"

/ {
	model = "Brighton Elliot i.MX8MPlus rev10 (Cortex-M7 / RPMsg)";
	dtb_filename = "imx8mp-elliot-m4_rev10.dtb";
	compatible = "ezurio,imx8mp-elliot-rpmsg", "brighton,imx8mp-elliot-rpmsg",
		     "ezurio,imx8mp-nitrogen8mp", "fsl,imx8mp";
};
