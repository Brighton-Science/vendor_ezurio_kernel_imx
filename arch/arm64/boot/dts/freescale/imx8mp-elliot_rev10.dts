// SPDX-License-Identifier: (GPL-2.0+ OR MIT)
/*
 * Brighton Elliot carrier board, rev10.
 *
 * Identical to imx8mp-elliot_rev20.dts except the AT8031 PHY interrupt is wired
 * to GPIO3_IO02 (rev20 uses GPIO3_IO14). Ported from the verified 12.1
 * imx8mp-elliot_rev10.dts.
 */

/dts-v1/;

#include "imx8mp-elliot.dts"

/ {
	model = "Brighton Elliot i.MX8MPlus rev10";
	dtb_filename = "imx8mp-elliot_rev10.dtb";
	/* rev10 is the default revision (U-Boot leaves ${board_rv} empty), so its
	 * first compatible is the bare ezurio,imx8mp-elliot — matching the bootscript
	 * dtexp ezurio,imx8mp-${board}${board_rv}${mcore} with board=elliot. */
	compatible = "ezurio,imx8mp-elliot", "brighton,imx8mp-elliot",
		     "ezurio,imx8mp-nitrogen8mp", "fsl,imx8mp";
};

/* ENET_QOS DISABLED — no PHY populated on the EQOS bus; see rev20 comment. */
&eqos {
	pinctrl-names = "default";
	pinctrl-0 = <&pinctrl_eqos>;
	phy-mode = "rgmii-id";
	phy-handle = <&ethphy_qos>;
	status = "disabled";

	mdio {
		compatible = "snps,dwmac-mdio";
		#address-cells = <1>;
		#size-cells = <0>;

		ethphy_qos: ethernet-phy@4 {
			compatible = "ethernet-phy-ieee802.3-c22";
			reg = <4>;
			at803x,hib-disabled;
			eee-broken-1000t;
			interrupt-parent = <&gpio3>;
			interrupts = <2 IRQ_TYPE_LEVEL_LOW>;
			rxc-skew-ps = <3000>;
			txc-skew-ps = <3000>;
			rxdv-skew-ps = <0>;
			txen-skew-ps = <0>;
		};
	};
};
